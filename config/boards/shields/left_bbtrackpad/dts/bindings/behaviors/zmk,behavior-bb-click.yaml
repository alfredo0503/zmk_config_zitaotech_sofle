## config/boards/shields/left_bbtrackpad/dts/bindings/behaviors/zmk,behavior-bb-click.yaml
```yaml
description: BB trackpad physical click (LOWER selects right click)
compatible: "zmk,behavior-bb-click"
include: zero_param.yaml
```

## config/boards/shields/left_bbtrackpad/dts/bindings/behaviors/zmk,behavior-keyboard-backlight-activity-sync.yaml
```yaml
description: Synchronize physical keyboard backlight activity across split halves
compatible: "zmk,behavior-keyboard-backlight-activity-sync"
include: zero_param.yaml
```

## config/boards/shields/left_bbtrackpad/dts/bindings/behaviors/zmk,behavior-lower-scroll-sync.yaml
```yaml
description: Synchronize LOWER-layer scroll mode across split halves
compatible: "zmk,behavior-lower-scroll-sync"
include: zero_param.yaml
```

## config/boards/shields/left_bbtrackpad/dts/bindings/behaviors/zmk,behavior-mouse-led-sync.yaml
```yaml
description: Synchronize BB trackpad LEDs with the temporary mouse layer
compatible: "zmk,behavior-mouse-led-sync"
include: zero_param.yaml
```

## config/dts/bindings/behaviors/zmk,behavior-keyboard-backlight-sync.yaml
```yaml
description: Synchronized keyboard backlight mode control across split halves
compatible: "zmk,behavior-keyboard-backlight-sync"
include: one_param.yaml
```
